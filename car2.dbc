VERSION ""

NS_ :

BS_:

BU_:

BO_ 50 speed: 8 Vector__XXX
 SG_ Signal_2 : 0|8@1+ (1,0) [0|255] "" Vector__XXX

BO_ 67 Engine: 8 Vector__XXX
 SG_ Signal_1 : 0|8@1+ (1,0) [0|255] "" Vector__XXX

BA_DEF_  "BusType" STRING ;
BA_DEF_DEF_  "BusType" "CAN";
