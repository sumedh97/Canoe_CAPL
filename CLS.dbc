VERSION ""

NS_ :

BS_:

BU_:

BO_ 50 LightState: 8 Vector__XXX
 SG_ Light : 0|8@1+ (1,0) [0|255] "" Vector__XXX

BO_ 291 EngineState: 2 Vector__XXX
 SG_ OnOff : 0|8@1+ (1,0) [0|255] "" Vector__XXX

BA_DEF_  "BusType" STRING ;
BA_DEF_DEF_  "BusType" "CAN";
